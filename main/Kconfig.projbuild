## main/Kconfig.projbuild
```kconfig
# JK-BMS -> MQTT Bridge for M5Stack Unit PoE-P4 (U213, legacy revision)
#
# Broker address, credentials, TLS, static IP and the RS485 debug switch are
# configured AT RUNTIME in the built-in web UI (stored in the NVS partition
# 'cfg', survives OTA). Only the technically fixed values stay here.

menu "JK-BMS to MQTT Bridge (M5Stack Unit PoE-P4)"

    config JKBMS_OTA_DEFAULT_URL
        string "Firmware update default URL (http/https)"
        default ""
        help
            Location of the firmware image for the "install firmware update"
            button in the web UI, e.g. "http://server/jkbridge.bin". HTTP is
            allowed (CONFIG_ESP_HTTPS_OTA_ALLOW_HTTP); for https:// the CA
            certificate from main/ca_cert.pem validates the server.
            MQTT updates stay independent of this (publish a URL to
            "<prefix>/ota"). Empty = the web-UI button is disabled.

    config JKBMS_RESET_BUTTON_GPIO
        int "Config-reset button GPIO (hold >= 10 s; -1 = disabled)"
        range -1 55
        default 34
        help
            Holding this button (idle high, pressed = low) for at least 10 s
            erases the configuration partition ('cfg': web password, DHCP/
            static IP, MQTT, debug) and reboots into the defaults: DHCP,
            web UI without password, MQTT off. Recovery path for a device
            unreachable via its network settings. The BOOT button of the
            ESP32-P4 EV boards / M5Stack PoE-P4 sits on GPIO 34 (input-only
            strap pin; harmless as input). Set -1 to disable the feature.

    config JKBMS_TOPIC_PREFIX
        string "MQTT topic prefix"
        default "jkbms"
        help
            Data is published to "<prefix>/state" (JSON), device availability
            on "<prefix>/available" (BMS link) and "<prefix>/mqtt_available"
            (broker connection). Home Assistant discovery uses
            "homeassistant/sensor/<prefix>-<device-id>/...".

    config JKBMS_HA_DISCOVERY
        bool "Home Assistant auto-discovery"
        default y
        help
            Disabled? Then only "<prefix>/state" is published.

    config JKBMS_POLL_INTERVAL_MS
        int "JK-BMS polling interval (ms)"
        range 1000 60000
        default 5000
        help
            The Modbus read requests are sent to the BMS at this interval.

    config JKBMS_CONFIG_READ_INTERVAL_MS
        int "Interval for re-reading the config/switch block (ms)"
        range 5000 3600000
        default 60000
        help
            Protection parameters and switch states (register block 0x1000)
            change rarely: they are re-read from the bus at most once per
            this interval (the first successful cycle always reads them).
            In between, the last known values remain part of the state topic.

    config JKBMS_STATE_HEARTBEAT_MS
        int "State topic heartbeat if nothing changes (ms)"
        range 5000 3600000
        default 60000
        help
            The state topic is published when values change. If nothing
            changes, it is re-published as a heartbeat at least once per
            this interval, so consumers can recognize an active feed and
            the retained message stays recent.

    config JKBMS_NO_RESPONSE_TIMEOUT_MS
        int "Timeout until 'BMS offline' if there is no response (ms)"
        range 5000 300000
        default 30000

    config JKBMS_MODBUS_SLAVE_ADDR
        int "Modbus RTU slave address of the BMS"
        range 0 15
        default 1
        help
            The BMS answers to this Modbus RTU address. On the RS485-1 (UART1)
            port the BMS is always a Modbus slave; the DIP switch on the
            control board (1-2-4-8 weights, ON = 1) selects the address
            0x00..0x0F. Set the switches to match this value (single pack:
            address 1 = switch 1 ON, rest OFF).

    menu "RS485 / UART"
        config JKBMS_RS485_UART_NUM
            int "UART number (UART0 is not usable: console)"
            range 1 3
            default 1

        config JKBMS_RS485_RX_GPIO
            int "RX GPIO (RO of the SP3485)"
            default 20

        config JKBMS_RS485_TX_GPIO
            int "TX GPIO (DI of the SP3485)"
            default 19

        config JKBMS_RS485_DE_GPIO
            int "DE/RE GPIO (both RE# and DE lines of the SP3485)"
            default 21
            help
                Actively controlled at 'high' during the transmission,
                receiver enabled again at 'low'.
    endmenu

    menu "Ethernet (internal EMAC + IP101GRI, Unit PoE-P4 U213 pinmap)"
        config JKBMS_ETH_MDC_GPIO
            int "SMI MDC GPIO"
            default 31

        config JKBMS_ETH_MDIO_GPIO
            int "SMI MDIO GPIO"
            default 52

        config JKBMS_ETH_PHY_RST_GPIO
            int "PHY reset GPIO"
            default 51

        config JKBMS_ETH_PHY_ADDR
            int "PHY address"
            range -1 31
            default 1
            help
                -1 = auto-detection. Default of the M5Stack UserDemo: 1.
    endmenu
endmenu
```
